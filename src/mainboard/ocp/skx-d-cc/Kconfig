## src/mainboard/ocp/skx-d-cc/Kconfig
```kconfig
## SPDX-License-Identifier: GPL-2.0-or-later

if BOARD_OCP_SKX_D_CC

config BOARD_SPECIFIC_OPTIONS
	def_bool y
	select BOARD_ROMSIZE_KB_32768
	select HAVE_ACPI_TABLES
	select DRIVERS_INTEL_PMC
	select DRIVERS_USB_ACPI	
	select SOC_INTEL_SKYLAKE_D
	select MAINBOARD_USES_FSP2_0
	select VPD

config MAINBOARD_DIR
	string
	default "ocp/skx-d-cc"

config MAINBOARD_PART_NUMBER
	string
	default "SKX-D-CC"

config MAINBOARD_FAMILY
	string
	default "SKX-D-CC"

config MAX_CPUS
	int
	default 8

config FMDFILE
	string
	default "src/mainboard/\$(CONFIG_MAINBOARD_DIR)/board.fmd"

endif # BOARD_OCP_SKX_D_CC
```

## src/soc/intel/common/block/systemagent_xeon/Kconfig
```kconfig
config SOC_INTEL_COMMON_BLOCK_SA_XEON
	bool
	help
	  Intel Processor common System Agent (XEON) support

if SOC_INTEL_COMMON_BLOCK_SA_XEON

config MMCONF_BASE_ADDRESS
	default 0xC0000000

config MMCONF_BUS_NUMBER
	default 256

endif
```

## src/soc/intel/xeon_d/Kconfig
```kconfig
# SPDX-License-Identifier: GPL-2.0-or-later

source "src/soc/intel/xeon_d/skx/Kconfig"

config XEON_D_COMMON_BASE
	bool

config SOC_INTEL_SKYLAKE_D
	bool
	select XEON_D_COMMON_BASE
	select PLATFORM_USES_FSP2_0
	help
	  Intel Skylake-D support

if XEON_D_COMMON_BASE

config	CPU_SPECIFIC_OPTIONS
	def_bool y
	select ARCH_X86
	select ACPI_INTEL_HARDWARE_SLEEP_VALUES
	select ARCH_ALL_STAGES_X86_32
	select BOOT_DEVICE_SUPPORTS_WRITES
	select CPU_INTEL_COMMON
	select CPU_INTEL_FIRMWARE_INTERFACE_TABLE
	select USES_MICROCODE_HEADER_FILES
	select CPU_MICROCODE_CBFS_EXTERNAL_HEADER
	select DRIVERS_UART
	select DRIVERS_UART_8250IO
	select CONSOLE_SERIAL
	select DEFAULT_CONSOLE_LOGLEVEL_8
#	select USE_CPU_MICROCODE_CBFS_BINS
	select FSP_PLATFORM_MEMORY_SETTINGS_VERSIONS
	select FSP_T_XIP
	select FSP_M_XIP
	select POSTCAR_STAGE
	select IOAPIC
	select PARALLEL_MP
	select REG_SCRIPT
	select INTEL_DESCRIPTOR_MODE_CAPABLE
	select SOC_INTEL_COMMON
	select SOC_INTEL_COMMON_SERVER
	select SOC_INTEL_COMMON_BLOCK
	select SOC_INTEL_COMMON_BLOCK_ACPI
	select SOC_INTEL_COMMON_BLOCK_ACPI_GPIO
	select SOC_INTEL_COMMON_BLOCK_CHIP_CONFIG
	select SOC_INTEL_COMMON_BLOCK_CPU
	select SOC_INTEL_COMMON_BLOCK_CPU_MPINIT
	select SOC_INTEL_COMMON_BLOCK_CPU_SMMRELOCATE
	select SOC_INTEL_COMMON_BLOCK_DMI
	select SOC_INTEL_COMMON_BLOCK_FAST_SPI
	select SOC_INTEL_COMMON_BLOCK_GPIO
	select SOC_INTEL_COMMON_BLOCK_GPIO_DUAL_ROUTE_SUPPORT
	select SOC_INTEL_COMMON_BLOCK_GPIO_PADCFG_PADTOL
	select SOC_INTEL_COMMON_BLOCK_ITSS
	select SOC_INTEL_COMMON_BLOCK_LPC
	select SOC_INTEL_COMMON_BLOCK_LPC_MIRROR_TO_DMI
	select SOC_INTEL_COMMON_BLOCK_RTC
	select SOC_INTEL_COMMON_BLOCK_SA_XEON
	select SOC_INTEL_COMMON_BLOCK_SATA
	select SOC_INTEL_COMMON_BLOCK_SGX
	select SOC_INTEL_COMMON_BLOCK_SMBUS
	select SOC_INTEL_COMMON_BLOCK_SMM
	select SOC_INTEL_COMMON_BLOCK_SPI
	select SOC_INTEL_COMMON_BLOCK_P2SB
	select SOC_INTEL_COMMON_BLOCK_PCIE
	select SOC_INTEL_COMMON_BLOCK_PMC
	select SOC_INTEL_COMMON_BLOCK_PMC_DISCOVERABLE
	select SOC_INTEL_COMMON_BLOCK_THERMAL
	select SOC_INTEL_COMMON_BLOCK_TIMER
	select SOC_INTEL_COMMON_BLOCK_TCO
	select SOC_INTEL_COMMON_BLOCK_XHCI
	select SOC_INTEL_COMMON_RESET
        select SOUTHBRIDGE_INTEL_COMMON_SMBUS
	select SSE2
#	select SUPPORT_CPU_UCODE_IN_CBFS
	select TSC_MONOTONIC_TIMER
	select TPM_STARTUP_IGNORE_POSTINIT if INTEL_TXT
	select UDELAY_TSC
	select FSP_CAR
	select SMM_TSEG
#	select HAVE_SMI_HANDLER
#	select X86_SMM_LOADER_VERSION2
	select REG_SCRIPT
	select NO_FSP_TEMP_RAM_EXIT
	select INTEL_CAR_NEM # For postcar only now

config MAINBOARD_USES_FSP2_0
	  bool
	  default y

config MAINBOARD_USES_IFD_GBE_REGION
	bool
	default y

config MAINBOARD_USES_IFD_EC_REGION
	bool
	default n

config MAINBOARD_USES_IFD_10GB_REGION
	bool
	default y

config MAINBOARD_USES_IFD_10GB_2_REGION
	bool
	default y

config USE_FSP2_0_DRIVER
	  def_bool y
	  depends on MAINBOARD_USES_FSP2_0
	  select PLATFORM_USES_FSP2_0
	  select UDK_202005_BINDING
	  select POSTCAR_STAGE

config MAX_SOCKET
	int
	default 1

config MAX_CPUS
	int
	default 8

config PCR_BASE_ADDRESS
	hex
	default 0xfd000000
	help
	  This option allows you to select MMIO Base Address of sideband bus.

config DCACHE_BSP_STACK_SIZE
	hex
	default 0x10000

config MMCONF_BASE_ADDRESS
	default 0xC0000000

config MMCONF_BUS_NUMBER
	default 256

config HEAP_SIZE
	hex
	default 0x80000

config MAX_ROOT_PORTS
	int
	default 24

config IFD_CHIPSET
	string
	default "sklkbl"

endif ## SOC_INTEL_XEON_D
```

## src/soc/intel/xeon_d/skx/Kconfig
```kconfig
config FSP_HEADER_PATH
	  string "Location of FSP headers"
	  depends on MAINBOARD_USES_FSP2_0
	  default "src/vendorcode/intel/fsp/fsp2_0/skylake_sp"

config CPU_ADDR_BITS
	int
	default 46

config DCACHE_RAM_BASE
	hex
	default 0xfe800000

config DCACHE_RAM_SIZE
	hex
	default 0x200000 if !FSP_CAR
	default 0x180000 if FSP_CAR  # 512K for FSP

config DCACHE_BSP_STACK_SIZE
	hex
	default 0x10000

config CPU_MICROCODE_CBFS_LOC
	hex
	default 0xfff0fdc0

config CPU_MICROCODE_CBFS_LEN
	hex
	default 0x7C00

config MMCONF_BASE_ADDRESS
        default 0xC0000000

config MMCONF_BUS_NUMBER
        default 256

config HEAP_SIZE
	hex
	default 0x80000
```

## src/southbridge/intel/common/firmware/Kconfig
```kconfig
# SPDX-License-Identifier: GPL-2.0-only

config HAVE_INTEL_FIRMWARE
	bool
	default y if INTEL_DESCRIPTOR_MODE_CAPABLE
	help
	  Platform uses the Intel Firmware Descriptor to describe the
	  layout of the SPI ROM chip. Enabling this option will allow you to
	  select further features that rely on this like providing individual
	  firmware blobs.

if HAVE_INTEL_FIRMWARE

comment "Intel Firmware"

config HAVE_IFD_BIN
	bool "Add Intel descriptor.bin file"
	select HAVE_EM100_SUPPORT  # We use ifdtool to enable this.
	help
	  The descriptor binary

config IFD_BIN_PATH
	string "Path and filename of the descriptor.bin file"
	default "3rdparty/blobs/mainboard/\$(MAINBOARDDIR)/descriptor.bin"
	depends on HAVE_IFD_BIN

config HAVE_ME_BIN
	bool "Add Intel ME/TXE firmware"
	depends on HAVE_IFD_BIN
	help
	  The Intel processor in the selected system requires a special firmware
	  for an integrated controller.  This might be called the Management
	  Engine (ME), the Trusted Execution Engine (TXE) or something else
	  depending on the chip. This firmware might or might not be available
	  in coreboot's 3rdparty/blobs repository. If it is not and if you don't
	  have access to the firmware from elsewhere, you can still build
	  coreboot without it. In this case however, you'll have to make sure
	  that you don't overwrite your ME/TXE firmware on your flash ROM.

config ME_BIN_PATH
	string "Path to management engine firmware"
	default "3rdparty/blobs/mainboard/\$(MAINBOARDDIR)/me.bin"
	depends on HAVE_ME_BIN

config CHECK_ME
	bool "Verify the integrity of the supplied ME/TXE firmware"
	default n
	depends on HAVE_ME_BIN && (NORTHBRIDGE_INTEL_IRONLAKE || \
		NORTHBRIDGE_INTEL_SANDYBRIDGE || \
		NORTHBRIDGE_INTEL_HASWELL || \
		SOC_INTEL_BROADWELL || SOC_INTEL_SKYLAKE || \
		SOC_INTEL_KABYLAKE || SOC_INTEL_BAYTRAIL || SOC_INTEL_BRASWELL)
	help
	  Verify the integrity of the supplied Intel ME/TXE firmware before
	  proceeding with the build, in order to prevent an accidental loading
	  of a corrupted ME/TXE image.

config ME_REGION_ALLOW_CPU_READ_ACCESS
	bool "Allows HOST/CPU read access to ME region"
	default y if SOC_INTEL_CSE_LITE_SKU
	default n
	help
	 The config ensures Host has read access to the ME region if it is locked
	 through LOCK_MANAGEMENT_ENGINE config. This config is enabled when the CSE
	 Lite SKU is integrated.

config USE_ME_CLEANER
	bool "Strip down the Intel ME/TXE firmware"
	depends on HAVE_ME_BIN && (NORTHBRIDGE_INTEL_IRONLAKE || \
		NORTHBRIDGE_INTEL_SANDYBRIDGE || \
		NORTHBRIDGE_INTEL_HASWELL || \
		SOC_INTEL_BROADWELL || SOC_INTEL_SKYLAKE || \
		SOC_INTEL_KABYLAKE || SOC_INTEL_BAYTRAIL || SOC_INTEL_BRASWELL)
	help
	  Use me_cleaner to remove all the non-fundamental code from the Intel
	  ME/TXE firmware.
	  The resulting Intel ME/TXE firmware will have only the code
	  responsible for the very basic hardware initialization, leaving the
	  ME/TXE subsystem essentially in a disabled state.

	  Don't flash a modified ME/TXE firmware and a new coreboot image at the
	  same time, test them in two different steps.

	  WARNING: this tool isn't based on any official Intel documentation but
	           only on reverse engineering and trial & error.

	  See the project's page
	   https://github.com/corna/me_cleaner
	  or the wiki
	   https://github.com/corna/me_cleaner/wiki/How-to-apply-me_cleaner
	   https://github.com/corna/me_cleaner/wiki/How-does-it-work%3F
	   https://github.com/corna/me_cleaner/wiki/me_cleaner-status
	  for more info about this tool

	  If unsure, say N.

comment "Please test the modified ME/TXE firmware and coreboot in two steps"
	depends on USE_ME_CLEANER

config ME_CLEANER_ARGS
	string
	depends on USE_ME_CLEANER
	default "-S"

config MAINBOARD_USES_IFD_GBE_REGION
	def_bool n

config HAVE_GBE_BIN
	bool "Add gigabit ethernet configuration"
	depends on HAVE_IFD_BIN && MAINBOARD_USES_IFD_GBE_REGION
	help
	  The integrated gigabit ethernet controller needs a configuration
	  file. Select this if you are going to use the PCH integrated
	  controller and want to add that file.

config GBE_BIN_PATH
	string "Path to gigabit ethernet configuration"
	depends on HAVE_GBE_BIN
	default "3rdparty/blobs/mainboard/\$(MAINBOARDDIR)/gbe.bin"

config MAINBOARD_USES_IFD_EC_REGION
	def_bool n

config HAVE_EC_BIN
	bool "Add EC firmware"
	depends on HAVE_IFD_BIN && MAINBOARD_USES_IFD_EC_REGION
	help
	  The embedded controller needs a firmware file.

	  Select this if you are going to use the PCH integrated controller
	  and have the EC firmware. EC firmware will be added to final image
	  through ifdtool.

config EC_BIN_PATH
	string "Path to EC firmware"
	depends on HAVE_EC_BIN
	default "3rdparty/blobs/mainboard/\$(MAINBOARDDIR)/ec.bin"

config MAINBOARD_USES_IFD_DEV_EXP_REGION
	def_bool n

config HAVE_DEV_EXP_1_BIN
	bool "Add Device Expansion Region 1"
	depends on HAVE_IFD_BIN && MAINBOARD_USES_IFD_DEV_EXP_REGION
	help
	  The device expansion region 1 firmware file.

	  Select this if you are going to use the device expansion region 1
	  and have the firmware. The firmware will be added to final image
	  through ifdtool.

config DEV_EXP_1_BIN_PATH
	string "Path to Device Expansion 1 firmware"
	depends on HAVE_DEV_EXP_1_BIN
	default "3rdparty/blobs/mainboard/\$(MAINBOARDDIR)/DeviceExp1.bin"

config MAINBOARD_USES_IFD_BIOS2_REGION
	def_bool n

config HAVE_BIOS2_BIN
	bool "Add BIOS 2 Region"
	depends on HAVE_IFD_BIN && MAINBOARD_USES_IFD_BIOS2_REGION
	help
	  The BIOS 2 region firmware file.

	  Select this if you are going to use the BIOS 2 region
	  and have the firmware. The firmware will be added to final image
	  through ifdtool.

config BIOS2_BIN_PATH
	string "Path to BIOS 2 firmware"
	depends on HAVE_BIOS2_BIN
	default "3rdparty/blobs/mainboard/\$(MAINBOARDDIR)/BIOS2Region.bin"

config MAINBOARD_USES_IFD_IE_REGION
	def_bool n

config HAVE_IE_BIN
	bool "Add Innovation Engine Region"
	depends on HAVE_IFD_BIN && MAINBOARD_USES_IFD_IE_REGION
	help
	  The Innovation Engine region firmware file.

	  Select this if you are going to use the Innovation Engine region
	  and have the firmware. The firmware will be added to final image
	  through ifdtool.

config IE_BIN_PATH
	string "Path to Innovation Engine firmware"
	depends on HAVE_IE_BIN
	default "3rdparty/blobs/mainboard/\$(MAINBOARDDIR)/IERegion.bin"

config MAINBOARD_USES_IFD_10GB_REGION
	def_bool n

config HAVE_10GB_BIN
	bool "Add 10GbE Firmware Region"
	depends on HAVE_IFD_BIN && MAINBOARD_USES_IFD_10GB_REGION
	help
	  The 10GbE region firmware file.

	  Select this if you are going to use the 10GbE region
	  and have the firmware. The firmware will be added to final image
	  through ifdtool.

config 10GB_BIN_PATH
	string "Path to 10GbE firmware"
	depends on HAVE_10GB_BIN
	default "3rdparty/blobs/mainboard/\$(MAINBOARDDIR)/10GbeARegion.bin"

config MAINBOARD_USES_IFD_10GB_2_REGION
	def_bool n
	depends on MAINBOARD_USES_10GB_REGION

config HAVE_10GB_2_BIN
	bool "Add 10GbE 2 Firmware Region"
	depends on HAVE_IFD_BIN && MAINBOARD_USES_IFD_10GB_2_REGION
	help
	  The 10GbE 2 region firmware file.

	  Select this if you are going to use the 10GbE 2 region
	  and have the firmware. The firmware will be added to final image
	  through ifdtool.

config 10GB_2_BIN_PATH
	string "Path to 10GbE 2 firmware"
	depends on HAVE_10GB_2_BIN
	default "3rdparty/blobs/mainboard/\$(MAINBOARDDIR)/10GbeARegion.bin"

config MAINBOARD_USES_IFD_PTT_REGION
	def_bool n

config HAVE_PTT_BIN
	bool "Add Platform Trust Technology Firmware Region"
	depends on HAVE_IFD_BIN && MAINBOARD_USES_IFD_PTT_REGION
	help
	  The Platform Trust Technology region firmware file.

	  Select this if you are going to use the PTT region
	  and have the firmware. The firmware will be added to final image
	  through ifdtool.

config PTT_BIN_PATH
	string "Path to Platform Trust Technology firmware"
	depends on HAVE_PTT_BIN
	default "3rdparty/blobs/mainboard/\$(MAINBOARDDIR)/PTTRegion.bin"

choice
	prompt "Protect flash regions"
	default UNLOCK_FLASH_REGIONS
	help
	  This option allows you to protect flash regions.

config DO_NOT_TOUCH_DESCRIPTOR_REGION
	bool "Use the preset values to protect the regions"
	help
	  Read and write access permissions to different regions in the flash
	  can be controlled via dedicated bitfields in the flash descriptor.
	  These permissions can be modified with the Intel Flash Descriptor
	  Tool (ifdtool). If you don't want to change these permissions and
	  keep the ones provided in the initial descriptor, use this option.

config LOCK_MANAGEMENT_ENGINE
	bool "Lock ME/TXE section"
	help
	  The Intel Firmware Descriptor supports preventing write and read
	  accesses from the host to the ME or TXE section. If the section
	  is locked, it can only be overwritten with an external SPI flash
	  programmer or HECI HMRFPO_ENABLE command needs to be sent to CSE
	  before writing to the ME Section. If CSE Lite SKU is integrated,
	  the Kconfig prevents only writing to the ME section.

	  If unsure, select "Unlock flash regions".

config UNLOCK_FLASH_REGIONS
	bool "Unlock flash regions"
	help
	  All regions are completely unprotected and can be overwritten using
	  a flash programming tool.

endchoice

config CBFS_SIZE
	hex
	default 0x100000
	help
	  Reduce CBFS size to give room to the IFD blobs.

endif #INTEL_FIRMWARE
```
